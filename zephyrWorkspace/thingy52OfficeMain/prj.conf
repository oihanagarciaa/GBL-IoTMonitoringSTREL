## CMakeLists.txt
```
cmake_minimum_required(VERSION 3.20.0)

set(BOARD "thingy52_nrf52832")

find_package(Zephyr REQUIRED HINTS $ENV{ZEPHYR_BASE})
project(Thingy52OfficeMonitoring)

FILE(GLOB app_sources src/*.c)
target_sources(app PRIVATE ${app_sources})
```

## prj.conf
```kconfig
# thingy52_nrf52832 board configuration

# Activate the sensors
# Most of the on-board devices are accessed through i2c
CONFIG_I2C=y
CONFIG_SENSOR=y

# Air quality sensors
CONFIG_CCS811=y

# Temperature and humidity sensors
CONFIG_HTS221=y
CONFIG_HTS221_TRIGGER_NONE=y
CONFIG_CBPRINTF_FP_SUPPORT=y

# enable rtc timer interface
CONFIG_NRF_RTC_TIMER=y
# allow allowcation of up to 1 timer
CONFIG_NRF_RTC_TIMER_USER_CHAN_COUNT=1

# To see the printk-s with JLinkRTTViewer
CONFIG_USE_SEGGER_RTT=y
CONFIG_RTT_CONSOLE=y
CONFIG_UART_CONSOLE=n

# Enable Bluetooth
CONFIG_BT=y
CONFIG_BT_PERIPHERAL=y
CONFIG_BT_DEVICE_NAME_DYNAMIC=y
CONFIG_BT_DEVICE_NAME="002"
```

## src/main.c
```c
/** Runtime Verification of spatio/temporal propperties over IoT networks
 */
#include "bluetooth.h"
#include "sensors.h"
#include "realTimeClock.h"

#define DEVICE_NAME CONFIG_BT_DEVICE_NAME
#define DEVICE_NAME_LEN (sizeof(DEVICE_NAME) - 1)

/* The main function */
int main() {
  init_sensors();
  initialize_realTimeClock();

  int err;
  
  err = initialize_bluetooth();
  if(err){
      printk("Bluetooth init failed (err %d)\n", err);
      return err;
  }

  register_callbacks();

  err = setup_advertisement_parameters();
  if (err) {
    printk("Advertising failed to start (err %d)\n", err);
    return err;
  } else {
    printk("Started advertising.\n");
  }

  return 0;
}
```

## src/bluetooth.c
```c
#include "bluetooth.h"

/* Declarations of read and write callbacks */
static ssize_t read_callback(struct bt_conn *conn,
                             const struct bt_gatt_attr *attr, void *buf,
                             uint16_t len, uint16_t offset) {
  // increase our meaningful data, use helper method to write it
  const char *message = getCurrentValues();

  return bt_gatt_attr_read(conn, attr, buf, len, offset, message, 125);
}
/* Write callback, currently, do nothing, also not used */
ssize_t write_callback(struct bt_conn *conn, const struct bt_gatt_attr *attr,
                       const void *buf, uint16_t len, uint16_t offset,
                       uint8_t flags) {
  return 0;
}

/* Some custom service uuids */
static struct bt_uuid_128 my_service_uuid = BT_UUID_INIT_128(
    BT_UUID_128_ENCODE(0x10362e64, 0x3e14, 0x11ec, 0x9bbc, 0x0242ac130002));
/* Custom characteristic*/
static struct bt_uuid_128 my_characteristics_uuid = BT_UUID_INIT_128(
    BT_UUID_128_ENCODE(0xa3bfe44d, 0x30c3, 0x4a29, 0xacf9, 0x3414fc8972d0));
/* Statically define my custom service with our custom characteristic, which is
 * readable */
BT_GATT_SERVICE_DEFINE(
    read_sensor_service, BT_GATT_PRIMARY_SERVICE(&my_service_uuid),
    BT_GATT_CHARACTERISTIC(
        &my_characteristics_uuid.uuid, // uuid
        BT_GATT_CHRC_READ,             // service-characteristics is readable
        BT_GATT_PERM_READ,             // read and write permissions
        &read_callback, &write_callback, (void *)1));


/* Connection reference counting object, is accessed when connecting and
 * disconnecting */
struct bt_conn *connection_ref;
/* Set up advertising data, we announce the custom service */
static const struct bt_data advertisement[] = {
    BT_DATA_BYTES(BT_DATA_FLAGS, (BT_LE_AD_GENERAL | BT_LE_AD_NO_BREDR)),
    BT_DATA_BYTES(BT_DATA_UUID128_ALL,
                  BT_UUID_128_ENCODE(0x10362e64, 0x3e14, 0x11ec, 0x9bbc,
                                     0x0242ac130002))};



static void connection_established(struct bt_conn *conn, uint8_t err) {
  char addr[BT_ADDR_LE_STR_LEN];

  if (err) {
    printk("Connection failed (err 0x%02x)\n", err);
    if (connection_ref) {
      bt_conn_unref(connection_ref);
      connection_ref = NULL;
    }
    return;
  }
  bt_set_name("see prj.conf");
  bt_addr_le_to_str(bt_conn_get_dst(conn), addr, sizeof(addr));

  printk("Connected: %s\n", addr);

  if (!connection_ref) {
    connection_ref = bt_conn_ref(conn);
  }
}

static void disconnecting(struct bt_conn *conn, uint8_t reason) {
  char addr[BT_ADDR_LE_STR_LEN];

  bt_addr_le_to_str(bt_conn_get_dst(conn), addr, sizeof(addr));

  printk("Disconnected %s (reason 0x%02x)\n", addr, reason);

  bt_conn_unref(connection_ref);
  connection_ref = NULL;
}

/* struct collecting connection callbacks (see above) */
struct bt_conn_cb beacon_connection_callbacks = {
    .connected = connection_established, .disconnected = disconnecting};


int initialize_bluetooth(){
  int err;
  err = bt_enable(NULL);
  return err;
}

void register_callbacks(){
    /* Register callbacks for connection establishment */
    bt_conn_cb_register(&beacon_connection_callbacks);
}
  
int setup_advertisement_parameters(){
  printk("Set up advertising.");
  int err;
  /* Set up advertisement parameters the complicated way - you can also use the
   * provided macros in bluetooth.h, e.g., BT_LE_ADV_CONN_NAME_AD*/
  struct bt_le_adv_param adv_param = {
      .id = BT_ID_DEFAULT,
      .sid = 0,
      .secondary_max_skip = 0,
      .options = (BT_LE_ADV_OPT_CONNECTABLE | BT_LE_ADV_OPT_USE_NAME |
                  BT_LE_ADV_OPT_FORCE_NAME_IN_AD),
      .interval_min = 0x0200, /* 200 ms, you can also use predefined values such
                                 as BT_GAP_ADV_FAST_INT_MIN_2 in gap.h */
      .interval_max = 0x0200, /* 200 ms */
      .peer = NULL,           /* undirected */
  };

  /* Use own parameters, own advertisement, no scan-response callback */
  err = bt_le_adv_start(&adv_param, advertisement, ARRAY_SIZE(advertisement),
                        NULL, 0);
  
  return err;
}
```

## src/bluetooth.h
```c
#include <bluetooth/bluetooth.h>
#include <bluetooth/conn.h>
#include <bluetooth/gap.h>
#include <bluetooth/gatt.h>
#include <bluetooth/hci.h>


int initialize_bluetooth();
void register_callbacks();
int setup_advertisement_parameters();
```

## src/sensors.c
```c
#include "sensors.h"

const struct device *tempHumdev;
const struct device *airDev;

const struct Values{
	double temp;
	double hum;
	int co2;
	int tvoc;
};
struct Values myValues;

static void readTempHumValues(const struct device *dev)
{
    struct sensor_value temp, hum;
	if (sensor_sample_fetch(dev) < 0) {
		printk("Sensor sample update error\n");
		return;
	}

	if (sensor_channel_get(dev, SENSOR_CHAN_AMBIENT_TEMP, &temp) < 0) {
		printk("Cannot read HTS221 temperature channel\n");
		return;
	}

	if (sensor_channel_get(dev, SENSOR_CHAN_HUMIDITY, &hum) < 0) {
		printk("Cannot read HTS221 humidity channel\n");
		return;
	}

	/* display temperature */
	double dtemp = sensor_value_to_double(&temp);
	myValues.temp = dtemp;
	printk("Temperature:%.1f C\n", dtemp);


	/* display humidity */
	double dhum = sensor_value_to_double(&hum);
	myValues.hum = dhum;
	printk("Relative Humidity:%.1f%%\n", dhum);
}

static void readAirValues(const struct device *dev)
{
    struct sensor_value co2, tvoc;
	int rc = 0;
	int baseline = -1;

	rc = ccs811_baseline_fetch(dev);
	if (rc >= 0) {
		baseline = rc;
		rc = 0;
	}

	if (rc == 0) {
		rc = sensor_sample_fetch(dev);
	}
	if (rc == 0) {
		const struct ccs811_result_type *rp = ccs811_result(dev);

		int carbonodioxido = sensor_channel_get(dev, SENSOR_CHAN_CO2, &co2);
		int tvoc1234 = sensor_channel_get(dev, SENSOR_CHAN_VOC, &tvoc);

		myValues.co2 = co2.val1;
		myValues.tvoc = tvoc.val1;
		printk("CCS811: %d ppm eCO2\n        %d ppb eTVOC\n", co2.val1, tvoc.val1);
    }
}

static void hts221_handler(const struct device *dev, const struct sensor_trigger *trig)
{
	readTempHumValues(dev);
    readAirValues(dev);
}

static void setUpTempHumDev(const struct device *tempHumdev)
{
	if (tempHumdev == NULL) {
		printk("Could not get HTS221 device\n");
		return;
	}

	if (IS_ENABLED(CONFIG_HTS221_TRIGGER)) {
		struct sensor_trigger trig = {
			.type = SENSOR_TRIG_DATA_READY,
			.chan = SENSOR_CHAN_ALL,
		};
		if (sensor_trigger_set(tempHumdev, &trig, hts221_handler) < 0) {
			printk("Cannot configure trigger\n");
			return;
		}
	}
}


static void setUpAirDev(const struct device *dev)
{
    static bool app_fw_2;
	struct ccs811_configver_type cfgver;
        int rc;

        if (!dev) {
		printk("Failed to get device binding");
		return;
	}

	printk("device is %p, name is %s\n", dev, dev->name);

	rc = ccs811_configver_fetch(dev, &cfgver);
	if (rc == 0) {
		printk("HW %02x; FW Boot %04x App %04x ; mode %02x\n",
		       cfgver.hw_version, cfgver.fw_boot_version,
		       cfgver.fw_app_version, cfgver.mode);
		app_fw_2 = (cfgver.fw_app_version >> 8) > 0x11;
	}
}

void init_sensors(){
    tempHumdev = device_get_binding("HTS221");
    setUpTempHumDev(tempHumdev);

    airDev = device_get_binding(DT_LABEL(DT_INST(0, ams_ccs811)));
    setUpAirDev(airDev);
}

char* getCurrentValues(){
  readTempHumValues(tempHumdev);
  readAirValues(airDev);
  static char values[125];

  unsigned long long time = 
    getRealTimeValue();

  sprintf(values, "%llu;%f;%f;%d;%d", 
    time, myValues.temp, myValues.hum, myValues.co2, myValues.tvoc);

  return values;
}
```

## src/sensors.h
```c
#include "realTimeClock.h"

#include <device.h>
#include <drivers/sensor/ccs811.h>
#include <stdio.h>
#include <stdlib.h>

void init_sensors();

char* getCurrentValues();
```
